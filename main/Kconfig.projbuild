## main/Kconfig.projbuild
```kconfig
menu "Smart Home Panel Configuration"

    config WIFI_SSID
        string "WiFi SSID"
        default "your_wifi_ssid"
        help
            WiFi network name to connect to.

    config WIFI_PASSWORD
        string "WiFi Password"
        default "your_wifi_password"
        help
            WiFi password.

    config HA_BASE_URL
        string "Home Assistant base URL"
        default "http://192.168.1.233:8123"
        help
            Home Assistant base URL (no trailing slash).

    config HA_TOKEN
        string "Home Assistant Long-Lived Access Token"
        default ""
        help
            Long-Lived Access Token from HA Profile page.

endmenu
```

## sdkconfig.defaults
```kconfig
# Smart Home Panel - sdkconfig defaults

# Chip revision (board has ESP32-P4 v1.0 — rev <3.0 is different hardware)
CONFIG_ESP32P4_SELECTS_REV_LESS_V3=y
CONFIG_ESP32P4_REV_MIN_100=y

# Flash size
CONFIG_ESPTOOLPY_FLASHSIZE_16MB=y

# CPU frequency
CONFIG_ESP_DEFAULT_CPU_FREQ_MHZ_400=y

# PSRAM
CONFIG_SPIRAM=y
CONFIG_SPIRAM_MODE_HEX=y
CONFIG_SPIRAM_SPEED_200M=y

# PSRAM bandwidth optimization (critical for MIPI DSI frame buffer DMA)
# Recommended by ESP-IoT-Solution for flicker-free DSI displays
CONFIG_SPIRAM_XIP_FROM_PSRAM=y
CONFIG_CACHE_L2_CACHE_256KB=y
CONFIG_CACHE_L2_CACHE_LINE_128B=y
CONFIG_COMPILER_OPTIMIZATION_PERF=y

# LVGL fonts
CONFIG_LV_FONT_MONTSERRAT_16=y
CONFIG_LV_FONT_MONTSERRAT_18=y
CONFIG_LV_FONT_MONTSERRAT_28=y
CONFIG_LV_FONT_MONTSERRAT_36=y

# Task watchdog (LVGL full-screen rendering can block CPU for >5s)
CONFIG_ESP_TASK_WDT_TIMEOUT_S=10
CONFIG_ESP_TASK_WDT_CHECK_IDLE_TASK_CPU0=n

# Partition table
CONFIG_PARTITION_TABLE_SINGLE_APP_LARGE=y
```

## sdkconfig.defaults.esp32p4
```kconfig
# ESP32-P4 specific defaults
# Board has chip revision v1.0
CONFIG_ESP32P4_REV_MIN_100=y
```
